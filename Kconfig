## Kconfig
```kconfig
source "techpack/mi845/input/Kconfig"
source "techpack/mi845/amplifier/Kconfig"
source "techpack/mi845/halls/Kconfig"
source "techpack/mi845/leds/Kconfig"
source "techpack/mi845/regulator/Kconfig"
```
